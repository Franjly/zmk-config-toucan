## boards/shields/nice_view_gem_toucan/Kconfig.shield
```kconfig
config SHIELD_NICE_VIEW_GEM_TOUCAN
    def_bool $(shields_list_contains,nice_view_gem_toucan)
```

## config/west.yml
```yaml
manifest:
  defaults:
    revision: v0.3
  remotes:
    - name: zmkfirmware
      url-base: https://github.com/zmkfirmware
    # Toucan
    - name: caksoylar
      url-base: https://github.com/caksoylar
    - name: geeksville
      url-base: https://github.com/geeksville
    # Prospector Scanner
    - name: prospector
      url-base: https://github.com/t-ogura
  projects:
    - name: zmk
      remote: zmkfirmware
      import: app/west.yml
    # Toucan
    - name: cirque-input-module
      remote: geeksville
      revision: toucan
    - name: zmk-rgbled-widget
      remote: caksoylar
      revision: main
    # Prospector Scanner
    - name: prospector-zmk-module
      remote: prospector
      repo-path: prospector-zmk-module
      revision: v2.0.0
  self:
    path: config
```
